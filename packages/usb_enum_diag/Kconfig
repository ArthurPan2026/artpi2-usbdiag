## packages/usb_enum_diag/Kconfig
```kconfig
# SPDX-License-Identifier: Apache-2.0
menuconfig PKG_USING_USB_ENUM_DIAG
    bool "usb_enum_diag: bounded USB enumeration rule-session core"
    default n
    help
      Add an allocation-free C99 core for validating USB enumeration evidence.
      This package does not initialize or own USB hardware.

if PKG_USING_USB_ENUM_DIAG

    config PKG_USB_ENUM_DIAG_PATH
        string
        default "/packages/peripherals/usb_enum_diag"

    choice
        prompt "Version"
        default PKG_USING_USB_ENUM_DIAG_V010
        help
          Select a fixed usb_enum_diag package version.

        config PKG_USING_USB_ENUM_DIAG_V010
            bool "v0.1.0"
    endchoice

    config PKG_USB_ENUM_DIAG_VER
        string
        default "v0.1.0" if PKG_USING_USB_ENUM_DIAG_V010

    config USB_ENUM_DIAG_BUILD_EXAMPLE
        bool "Build the optional RT-Thread startup/MSH smoke test"
        depends on RT_USING_COMPONENTS_INIT
        default n

endif
```

## packages/watchdog_crashlog/Kconfig
```kconfig
# SPDX-License-Identifier: Apache-2.0
menuconfig PKG_USING_WATCHDOG_CRASHLOG
    bool "watchdog_crashlog: portable fault and event record core"
    default n
    help
      Add the portable C99 watchdog record core. Hardware watchdog setup,
      retained-memory placement, CPU fault entry, and product flash logging
      remain the responsibility of the BSP or application.

if PKG_USING_WATCHDOG_CRASHLOG

    config PKG_WATCHDOG_CRASHLOG_PATH
        string
        default "/packages/peripherals/watchdog_crashlog"

    choice
        prompt "Version"
        default PKG_USING_WATCHDOG_CRASHLOG_V010
        help
          Select a fixed watchdog_crashlog package version.

        config PKG_USING_WATCHDOG_CRASHLOG_V010
            bool "v0.1.0"
    endchoice

    config PKG_WATCHDOG_CRASHLOG_VER
        string
        default "v0.1.0" if PKG_USING_WATCHDOG_CRASHLOG_V010

    config PKG_USING_WATCHDOG_CRASHLOG_RTT_SUPERVISOR
        bool "Optional RT-Thread single-feeder supervisor adapter"
        default n
        help
          Build the RT-Thread thread adapter. The consumer supplies health
          policy and the actual hardware watchdog feed callback.

endif
```

## packages/wifi_profile_manager/Kconfig
```kconfig
menuconfig PKG_USING_WIFI_PROFILE_MANAGER
    bool "Portable Wi-Fi profile manager core"
    default n
    help
      Bounded C99 Wi-Fi profile and connection policy core. Radio and
      persistence operations are executed by the application adapter.

if PKG_USING_WIFI_PROFILE_MANAGER

    config PKG_WIFI_PROFILE_MANAGER_PATH
        string
        default "/packages/iot/wifi_profile_manager"

    choice
        prompt "Version"
        default PKG_USING_WIFI_PROFILE_MANAGER_V010
        help
          Select a fixed wifi_profile_manager package version.

        config PKG_USING_WIFI_PROFILE_MANAGER_V010
            bool "v0.1.0"
    endchoice

    config PKG_WIFI_PROFILE_MANAGER_VER
        string
        default "v0.1.0" if PKG_USING_WIFI_PROFILE_MANAGER_V010

    config WPM_PROFILE_MAX
        int "Maximum saved Wi-Fi profiles"
        range 1 8
        default 8

    config PKG_USING_WIFI_PROFILE_MANAGER_NV
        bool "Transactional profile persistence journal"
        default n
        help
          Enable the optional allocation-free two-sector journal for opaque
          profile payloads. The application must provide read, 16-byte
          program, and sector erase callbacks plus the storage geometry.
          The module does not access hardware or encrypt credentials.

    config WPM_BUILD_EXAMPLE
        bool "Build adapter boundary smoke example"
        depends on RT_USING_COMPONENTS_INIT
        default n

endif
```
